## app/silver_guardian_band/Kconfig
```kconfig
config SILVER_GUARDIAN_BAND
	bool "Silver Guardian Band Application"
	default n
	---help---
		Enable Silver Guardian Band application for elderly care.

		Core features:
		- SOS emergency call
		- Sitting detection
		- BLE communication
		- LVGL UI

if SILVER_GUARDIAN_BAND

config SILVER_GUARDIAN_BAND_PRIORITY
	int "Silver Guardian Band task priority"
	default 100
	---help---
		Priority of the main task.

config SILVER_GUARDIAN_BAND_STACKSIZE
	int "Silver Guardian Band stack size"
	default 8192
	---help---
		Stack size for the main task.

config SOS_BUTTON_PIN
	int "SOS button GPIO pin"
	default 1
	---help---
		GPIO pin number for SOS button.

config SOS_PRESS_DURATION
	int "SOS long press duration (ms)"
	default 3000
	---help---
		Duration in milliseconds to trigger SOS.

config SITTING_THRESHOLD
	int "Sitting reminder threshold (seconds)"
	default 3600
	---help---
		Time in seconds before sitting reminder.

config STILL_THRESHOLD
	int "Long still alert threshold (seconds)"
	default 7200
	---help---
		Time in seconds before still alert.

config IMU_SAMPLE_RATE
	int "IMU sample rate (Hz)"
	default 100
	---help---
		IMU data sampling rate.

config BLE_ENABLED
	bool "Enable BLE communication"
	default y
	---help---
		Enable Bluetooth Low Energy communication.

endif # SILVER_GUARDIAN_BAND
```

## app/silver_guardian_hub/Kconfig
```kconfig
#
# For a description of the syntax of this configuration file,
# see the file kconfig-language.txt in the NuttX tools repository.
#

config LVX_USE_DEMO_CONTEST2026_325_SILVER_GUARDIAN_HUB
	bool "Silver Guardian Hub (elderly care)"
	default n
	---help---
		Enable Silver Guardian Hub application for elderly care.

		Single-board interactive features (no wristband or cloud required):
		- Touch-driven multi-page UI (home / menu / medication / health /
		  events / settings / about / touch self-test)
		- Medication reminder with plans persisted to /data
		- On-board I2C sensors: SHTC3 (temp/humi), LTR553 (light/prox),
		  SGP30 (CO2/TVOC)
		- Local alert tones generated in code (no audio files needed)
		- SOS / sitting alerts with an overlay on top of every page

		Fonts: the app ships its own GB2312 Chinese bitmap fonts
		(src/fonts/, generated by tools/gen_lvgl_fonts.sh). Do NOT rely on
		LV_FONT_SIMSUN_16_CJK -- that example font only carries 1166 CJK
		glyphs and cannot render "银发守护".
```
